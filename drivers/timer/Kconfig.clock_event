## drivers/timer/Kconfig.clock_event
```kconfig
# Copyright The Zephyr Project Contributors
# SPDX-License-Identifier: Apache-2.0

config CLOCK_EVENT_SYSTEM_TIMER
	bool "System timer on the scheduler clock service"
	select CLOCK_EVENT_SCHED
	select TICKLESS_CAPABLE
	select TIMER_HAS_64BIT_CYCLE_COUNTER
	help
	  Implement the system clock on k_clock_event_sched_now() and one
	  scheduler clock-event client. Hardware cycles are the service's
	  logical timebase, so every registered clock-event provider feeds
	  system time: the fastest active-only provider while the CPU runs and
	  the deep-sleep provider across deeper PM states. The SoC supplies the
	  providers; this driver names none.

config CLOCK_EVENT_SYSTEM_TIMER_MAX_TIMEOUT_MS
	int "Longest single timeout (ms)"
	depends on CLOCK_EVENT_SYSTEM_TIMER
	default 1000
	range 1 30000
	help
	  Upper bound for one hardware arm. Each deep-sleep expiry re-anchors the
	  providers, so this also bounds how long their relative drift can
	  accumulate while the CPU is awake.

config CLOCK_EVENT_SYSTEM_TIMER_JOB
	bool "Kernel timeouts expire in a deadline job"
	depends on CLOCK_EVENT_SYSTEM_TIMER
	depends on SCHED_DEADLINE && !SMP && !TIMESLICING
	help
	  The clock-event interrupt only releases a deadline job, which
	  announces the elapsed ticks: kernel timeout callbacks (thread
	  wake-ups, k_timer handlers, delayed work) run in that job instead of
	  in the interrupt (k_is_in_isr() is false there; timer_api's
	  test_timer_expiry_in_isr fails by design). Announcements are at least
	  CLOCK_EVENT_SYSTEM_TIMER_JOB_MIN_INTERARRIVAL_NS apart: a timeout due
	  sooner after the last one is served at that spacing.

if CLOCK_EVENT_SYSTEM_TIMER_JOB

config CLOCK_EVENT_SYSTEM_TIMER_JOB_PRIORITY
	int "Priority of the announcing job"
	default -1
	range -128 -1
	help
	  A cooperative priority: a timeout callback runs to completion before
	  another thread anchors a timeout of its own.

config CLOCK_EVENT_SYSTEM_TIMER_JOB_STACK_SIZE
	int "Stack size of the announcing job"
	default 512

config CLOCK_EVENT_SYSTEM_TIMER_JOB_DEADLINE_NS
	int "Start-by of an announcement after its expiry (ns)"
	default 1000000
	help
	  The deadline each expiry releases the announcing job with.

config CLOCK_EVENT_SYSTEM_TIMER_JOB_MIN_INTERARRIVAL_NS
	int "Shortest time between two announcements (ns)"
	default 1000000
	help
	  Must be at least CLOCK_EVENT_SYSTEM_TIMER_JOB_DEADLINE_NS.

config CLOCK_EVENT_SYSTEM_TIMER_JOB_BUDGET_NS
	int "Worst-case run of one announcement (ns)"
	default 0
	help
	  Nonzero arms the announcing job (k_deadline_event_arm()) with this
	  budget, CLOCK_EVENT_SYSTEM_TIMER_JOB_MIN_INTERARRIVAL_NS and
	  CLOCK_EVENT_SYSTEM_TIMER_JOB_DEADLINE_NS, and
	  CLOCK_EVENT_SYSTEM_TIMER_JOB_ISR_NS as the interrupt that releases
	  it. 0 leaves it outside admission.

config CLOCK_EVENT_SYSTEM_TIMER_JOB_ISR_NS
	int "Interrupt handling of one expiry (ns)"
	default 0

endif # CLOCK_EVENT_SYSTEM_TIMER_JOB
```

## drivers/timer/Kconfig.silabs
```kconfig
# Copyright (c) 2024 Silicon Laboratories Inc.
# SPDX-License-Identifier: Apache-2.0

DT_CHOSEN_SILABS_SLEEPTIMER := silabs,sleeptimer

config SILABS_SLEEPTIMER_TIMER
	bool "Silabs Sleeptimer system clock driver"
	depends on SOC_FAMILY_SILABS_S1 || SOC_FAMILY_SILABS_S2 || SOC_FAMILY_SILABS_S3 \
		|| SOC_FAMILY_SILABS_SIWX91X
	depends on $(dt_chosen_enabled,$(DT_CHOSEN_SILABS_SLEEPTIMER))
	select SILABS_GECKO_SLEEPTIMER if HAS_SILABS_GECKO
	select SILABS_SISDK_SLEEPTIMER if HAS_SILABS_SISDK || HAS_SILABS_WISECONNECT
	select TICKLESS_CAPABLE
	select TIMER_READS_ITS_FREQUENCY_AT_RUNTIME
	help
	  This module implements a kernel device driver for the sleeptimer
	  and provides the standard "system clock driver" interfaces.

config SILABS_BURTC_CLOCK_EVENT
	bool "Silabs BURTC deep-sleep clock-event provider"
	depends on SOC_FAMILY_SILABS_S2
	depends on DT_HAS_SILABS_BURTC_COUNTER_ENABLED
	depends on !COUNTER_SILABS_BURTC
	select CLOCK_EVENT
	select SILABS_SISDK_BURTC
	help
	  Own the BURTC and register it as a clock-event provider that keeps
	  running in deep sleep. Its single COMP is shared by a fixed set of
	  events. Use it with CLOCK_EVENT_SYSTEM_TIMER; the BURTC Counter driver
	  must be disabled.

if SILABS_BURTC_CLOCK_EVENT

config SILABS_BURTC_CLOCK_EVENT_SLOTS
	int "BURTC clock-event slots"
	default 1 if CLOCK_EVENT_SCHED
	default 2
	range 1 32

config SILABS_BURTC_CLOCK_EVENT_INIT_PRIORITY
	int "BURTC clock-event provider init priority"
	default 40
	help
	  PRE_KERNEL_1 priority; must follow the clock controller.

endif # SILABS_BURTC_CLOCK_EVENT
```

## subsys/timing/Kconfig
```kconfig
# Copyright (c) 2020 Intel Corporation
#
# SPDX-License-Identifier: Apache-2.0

config TIMING_FUNCTIONS
	bool "Timing Functions"
	help
	  When enabled, timing related functions are compiled. This is
	  useful for gathering timing on code execution.

config TIMING_FUNCTIONS_NEED_AT_BOOT
	bool
	select TIMING_FUNCTIONS
	help
	  Hidden option to indicate that timing functions need to be
	  initialized at boot.

	  To be selected by kernel and other subsystems which need
	  to use timing functions.

DT_CHOSEN_ZEPHYR_TIMING_COUNTER := zephyr,timing-counter

config TIMING_SYS_CLOCK
	bool "Timing functions backed by the system clock"
	depends on TIMER_HAS_64BIT_CYCLE_COUNTER
	depends on !TIMING_COUNTER
	select TIMING_FUNCTIONS
	select SOC_HAS_TIMING_FUNCTIONS
	help
	  Implement the timing API on k_cycle_get_64(), for system timers whose cycle count is
	  fine-grained and keeps advancing in every sleep state the system enters, such as
	  CLOCK_EVENT_SYSTEM_TIMER. The CPU cycle counter stops in sleep; this does not.

config TIMING_COUNTER
	bool "Timing functions backed by a Counter device"
	default y if $(dt_chosen_enabled,$(DT_CHOSEN_ZEPHYR_TIMING_COUNTER))
	depends on $(dt_chosen_enabled,$(DT_CHOSEN_ZEPHYR_TIMING_COUNTER))
	select COUNTER
	select TIMING_FUNCTIONS
	select SOC_HAS_TIMING_FUNCTIONS
	help
	  Implement the timing API (timing_counter_get(), timing_cycles_get(), timing_ns_get(), ...)
	  on top of the Counter device chosen as "zephyr,timing-counter", for SoCs that have no
	  timing backend of their own and where the CPU cycle counter is not suitable (it stops in
	  sleep, and it only exists on some cores).

	  The value returned by timing_counter_get() is 64 bits wide. The hardware count is folded
	  into it whenever the clock is read, and an alarm armed half a counter period ahead of the
	  last fold guarantees that it is folded often enough even if nobody reads the clock.

	  The chosen counter must be free-running, must support one alarm channel, and must keep
	  counting in every sleep state the system enters (for example an RTC). This option does
	  not restrict sleeping.
```

## tests/kernel/clock_event/testcase.yaml
```yaml
tests:
  kernel.clock_event:
    tags:
      - kernel
      - timer
    integration_platforms:
      - native_sim
```

## tests/kernel/clock_event_sched/testcase.yaml
```yaml
tests:
  kernel.clock_event_sched:
    tags:
      - kernel
      - timer
    integration_platforms:
      - native_sim
```

## tests/kernel/clock_event_timer/testcase.yaml
```yaml
tests:
  kernel.clock_event_timer:
    tags:
      - kernel
      - timer
    platform_allow:
      - native_sim
      - native_sim/native/64
    integration_platforms:
      - native_sim
```

## tests/kernel/deferred_release/testcase.yaml
```yaml
tests:
  kernel.deferred_release:
    tags:
      - kernel
      - timer
    integration_platforms:
      - native_sim
```
